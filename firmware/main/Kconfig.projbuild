## firmware/main/Kconfig.projbuild
```kconfig
menu "BitBot hardware bring-up"
    config BITBOT_DISPLAY_ENABLED
        bool "Enable verified 8-pin ST7789 240x240 display wiring"
        default y
        help
            SCK=D8/GPIO7, SDA=D10/GPIO9, RES=D1/GPIO2, DC=D4/GPIO5, CS=D3/GPIO4.
            VCC and BL to 3V3; BL is not GPIO-driven. No SD card may be
            inserted or initialized.
    config BITBOT_DISPLAY_INVERT
        bool "Invert panel colors"
        default y
    config BITBOT_DISPLAY_BGR
        bool "Use BGR color order"
        default n
    config BITBOT_DISPLAY_Y_GAP
        int "Panel row offset (verify on the actual module)"
        range 0 80
        default 0
    config BITBOT_DISPLAY_SPI_MHZ
        int "Display SPI clock in MHz (lower it if the image glitches)"
        range 10 80
        default 40
    config BITBOT_DISPLAY_DIM_SECONDS
        int "Dim the screen after this many idle seconds (0 disables dimming)"
        range 0 3600
        default 30
        help
            Idle means no conversation: the bot is only listening for "Hey
            Robot". The wake phrase, the button and any status change undim it.
    config BITBOT_DISPLAY_DIM_PERCENT
        int "Screen brightness while dimmed, in percent"
        range 0 100
        default 20
        help
            BL is wired to 3V3, so this darkens the pixels, not the backlight.
            The panel still glows at 0; only rewiring BL to a GPIO fixes that.
    config BITBOT_DISPLAY_EXPRESSION_DEMO
        bool "Cycle through all facial expressions every 4 s (for tuning)"
        default n
endmenu
```
